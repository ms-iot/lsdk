## configs/linux/linux_arm32.its
```
/*
 * Copyright 2017 NXP
 *
 */


/dts-v1/;

/ {
	description = "Image file for the QorIQ ARM 32b Linux Kernel";
	#address-cells = <1>;

	images {
		kernel-v7 {
			description = "ARM32 Linux kernel";
			data = /incbin/("../../build/linux/kernel/arm32/zImage.v7");
			type = "kernel";
			arch = "arm";
			os = "linux";
			compression = "none";
			load = <0x80008000>;
			entry = <0x80008000>;
		};

                kernel-v8 {
                        description = "ARM32 Linux kernel";
                        data = /incbin/("../../build/linux/kernel/arm32/zImage.v8");
                        type = "kernel";
                        arch = "arm";
                        os = "linux";
                        compression = "none";
                        load = <0x80008000>;
                        entry = <0x80008000>;
                };

		initrd {
			description = "initrd for arm32";
			data = /incbin/("../../packages/rfs/ramdiskrfs/ramdisk_rootfs_arm32.ext4.gz");
			type = "ramdisk";
			arch = "arm";
			os = "linux";
			compression = "none";
		};


		ls1021atwr-dtb {
			description = "Flattened Device Tree blob";
			data = /incbin/("../../build/linux/kernel/arm32/ls1021a-twr.dtb");
			type = "flat_dt";
			arch = "arm";
			compression = "none";
			load = <0x90000000>;
		};


                ls1043ardb-dtb {
                        description = "Flattened Device Tree blob";
                        data = /incbin/("../../build/linux/kernel/arm32/fsl-ls1043a-rdb-sdk.dtb");
                        type = "flat_dt";
                        arch = "arm";
                        compression = "none";
                        load = <0x9ffe0000>;
                };

                ls1046ardb-dtb {
                        description = "Flattened Device Tree blob";
                        data = /incbin/("../../build/linux/kernel/arm32/fsl-ls1046a-rdb-sdk.dtb");
                        type = "flat_dt";
                        arch = "arm";
                        compression = "none";
                        load = <0x9ffe0000>;
                };

                ls1012ardb-dtb {
                        description = "Flattened Device Tree blob";
                        data = /incbin/("../../build/linux/kernel/arm32/fsl-ls1012a-rdb.dtb");
                        type = "flat_dt";
                        arch = "arm";
                        compression = "none";
                        load = <0x9ffe0000>;
                };

                ls1012afrwy-dtb {
                        description = "Flattened Device Tree blob";
                        data = /incbin/("../../build/linux/kernel/arm32/fsl-ls1012a-frwy.dtb");
                        type = "flat_dt";
                        arch = "arm";
                        compression = "none";
                };


                ls1012grapeboard-dtb {
                        description = "Flattened Device Tree blob";
                        data = /incbin/("../../build/linux/kernel/arm32/grapeboard.dtb");
                        type = "flat_dt";
                        arch = "arm";
                        compression = "none";
                        load = <0x9ffe0000>;
                };
	};

	configurations {
		ls1021atwr {
			description = "Boot Linux kernel";
			kernel = "kernel-v7";
			fdt = "ls1021atwr-dtb";
			ramdisk = "initrd";
		};

                ls1043ardb {
                        description = "Boot Linux kernel";
                        kernel = "kernel-v8";
                        fdt = "ls1043ardb-dtb";
                        ramdisk = "initrd";
                };

                ls1046ardb {
                        description = "Boot Linux kernel";
                        kernel = "kernel-v8";
                        fdt = "ls1046ardb-dtb";
                        ramdisk = "initrd";
                };

                ls1012ardb {
                        description = "Boot Linux kernel";
                        kernel = "kernel-v8";
                        fdt = "ls1012ardb-dtb";
                        ramdisk = "initrd";
                };

		ls1012afrwy {
                        description = "Boot Linux kernel";
                        kernel = "kernel-v8";
                        fdt = "ls1012afrwy-dtb";
                        ramdisk = "initrd";
		};


		ls1012grapeboard {
			description = "Boot Linux kernel";
			kernel = "kernel-v8";
			fdt = "ls1012grapeboard-dtb";
			ramdisk = "initrd";
		};
	};
};
```

## configs/linux/linux_arm64.its
```
/*
 * Copyright 2017 NXP
 *
 */


/dts-v1/;

/ {
	description = "arm64 kernel, ramdisk and FDT blob";
	#address-cells = <1>;

	images {
		kernel {
			description = "ARM64 Kernel";
			data = /incbin/("../../build/linux/kernel/arm64/Image.gz");
			type = "kernel";
			arch = "arm64";
			os = "linux";
			compression = "gzip";
			load = <0x80080000>;
			entry = <0x80080000>;
			hash@1 {
				algo = "crc32";
			};
		};

		initrd {
			description = "initrd for arm64";
			data = /incbin/("../../packages/rfs/ramdiskrfs/ramdisk_rootfs_arm64.ext4.gz");
			type = "ramdisk";
			arch = "arm64";
			os = "linux";
			compression = "none";
			load = <0x00000000>;
			entry = <0x00000000>;
			hash@1 {
				algo = "crc32";
			};
		};

		ls2080ardb-dtb {
			description = "ls2080ardb-dtb";
			data = /incbin/("../../build/linux/kernel/arm64/fsl-ls2080a-rdb.dtb");
			type = "flat_dt";
			arch = "arm64";
			os = "linux";
			compression = "none";
			load = <0x90000000>;
			hash@1 {
				algo = "crc32";
			};
		};

		ls2088ardb-dtb {
			description = "ls2088ardb-dtb";
			data = /incbin/("../../build/linux/kernel/arm64/fsl-ls2088a-rdb.dtb");
			type = "flat_dt";
			arch = "arm64";
			os = "linux";
			compression = "none";
			load = <0x90000000>;
			hash@1 {
				algo = "crc32";
			};
		};

		ls1088ardb-dtb {
			description = "ls1088ardb-dtb";
			data = /incbin/("../../build/linux/kernel/arm64/fsl-ls1088a-rdb.dtb");
			type = "flat_dt";
			arch = "arm64";
			os = "linux";
			compression = "none";
			load = <0x90000000>;
			hash@1 {
				algo = "crc32";
			};
		};

		ls1043ardb-dtb {
			description = "ls1043ardb-dtb";
			data = /incbin/("../../build/linux/kernel/arm64/fsl-ls1043a-rdb-sdk.dtb");
			type = "flat_dt";
			arch = "arm64";
			os = "linux";
			compression = "none";
			load = <0x90000000>;
			hash@1 {
				algo = "crc32";
			};
		};

		ls1046ardb-dtb {
			description = "ls1046ardb-dtb";
			data = /incbin/("../../build/linux/kernel/arm64/fsl-ls1046a-rdb-sdk.dtb");
			type = "flat_dt";
			arch = "arm64";
			os = "linux";
			compression = "none";
			load = <0x90000000>;
			hash@1 {
				algo = "crc32";
			};
		};

		ls1012ardb-dtb {
			description = "ls1012ardb-dtb";
			data = /incbin/("../../build/linux/kernel/arm64/fsl-ls1012a-rdb.dtb");
			type = "flat_dt";
			arch = "arm64";
			os = "linux";
			compression = "none";
			load = <0x90000000>;
			hash@1 {
				algo = "crc32";
			};
		};

		ls1012afrwy-dtb {
			description = "ls1012afrwy-dtb";
			data = /incbin/("../../build/linux/kernel/arm64/fsl-ls1012a-frwy.dtb");
			type = "flat_dt";
			arch = "arm64";
			os = "linux";
			compression = "none";
			load = <0x90000000>;
			hash@1 {
				algo = "crc32";
			};
		};

		ls1012grapeboard-dtb {
			description = "ls1012grapeboard-dtb";
			data = /incbin/("../../build/linux/kernel/arm64/ls1012grapeboard.dtb");
			type = "flat_dt";
			arch = "arm64";
			os = "linux";
			compression = "none";
			load = <0x90000000>;
			hash@1 {
				algo = "crc32";
			};
		};
	};

	configurations {
		ls2080ardb {
			description = "config for ls2080ardb";
			kernel = "kernel";
			ramdisk = "initrd";
			fdt = "ls2080ardb-dtb";
		};

		ls2088ardb {
			description = "config for ls2088ardb";
			kernel = "kernel";
			ramdisk = "initrd";
			fdt = "ls2088ardb-dtb";
		};

		ls1088ardb {
			description = "config for ls1088ardb";
			kernel = "kernel";
			ramdisk = "initrd";
			fdt = "ls1088ardb-dtb";
		};

		ls1043ardb {
			description = "config for ls1043ardb";
			kernel = "kernel";
			ramdisk = "initrd";
			fdt = "ls1043ardb-dtb";
		};

		ls1046ardb {
			description = "config for ls1046ardb";
			kernel = "kernel";
			ramdisk = "initrd";
			fdt = "ls1046ardb-dtb";
		};

		ls1012ardb {
			description = "config for ls1012ardb";
			kernel = "kernel";
			ramdisk = "initrd";
			fdt = "ls1012ardb-dtb";
		};

		ls1012afrwy {
			description = "config for ls1012afrwy";
			kernel = "kernel";
			ramdisk = "initrd";
			fdt = "ls1012afrwy-dtb";
		};

		ls1012grapeboard {
			description = "config for ls1012grapeboard";
			kernel = "kernel";
			ramdisk = "initrd";
			fdt = "ls1012grapeboard-dtb";
		};
	};
};
```

## configs/linux/linux_ppc32.its
```
/*
 * Copyright 2017 NXP
 *
 */


/dts-v1/;

/ {
	description = "powerpc kernel, ramdisk and FDT blob";
	#address-cells = <1>;

	images {
		kernel {
			description = "ppc32 kernel";
			data = /incbin/("../../build/linux/kernel/ppc32/Image.gz");
			type = "kernel";
			arch = "powerpc";
			os = "linux";
			compression = "gzip";
			load = <0x0>;
			entry = <0x0>;
			hash@1 {
				algo = "crc32";
			};
		};

		initrd {
			description = "initrd for ppc32";
			data = /incbin/("../../packages/rfs/initrds/initrd.ppc32.cpio.gz");
			type = "ramdisk";
			arch = "powerpc";
			os = "linux";
			compression = "none";
			load = <0x1000000>;
			entry = <0x1000000>;
			hash@1 {
				algo = "crc32";
			};
		};

		mpc8548cds-dtb {
			description = "mpc8548cds-dtb";
			data = /incbin/("../../build/linux/kernel/ppc32/mpc8548cds_32b.dtb");
			type = "flat_dt";
			arch = "powerpc";
			os = "linux";
			compression = "none";
			hash@1 {
				algo = "crc32";
			};
		};

		p1010rdb-dtb {
			description = "p1010rdb-pb-dtb";
			data = /incbin/("../../build/linux/kernel/ppc32/p1010rdb-pb.dtb");
			type = "flat_dt";
			arch = "powerpc";
			os = "linux";
			compression = "none";
			hash@1 {
				algo = "crc32";
			};
		};

		p2020rdb-dtb {
			description = "p2020rdb-dtb-pc-32b";
			data = /incbin/("../../build/linux/kernel/ppc32/p2020rdb-pc_32b.dtb");
			type = "flat_dt";
			arch = "powerpc";
			os = "linux";
			compression = "none";
			hash@1 {
				algo = "crc32";
			};
		};

		p2041rdb-dtb {
			description = "p2041rdb-dtb";
			data = /incbin/("../../build/linux/kernel/ppc32/p2041rdb.dtb");
			type = "flat_dt";
			arch = "powerpc";
			os = "linux";
			compression = "none";
			hash@1 {
				algo = "crc32";
			};
		};

		p3041ds-dtb {
			description = "p3041ds-dtb";
			data = /incbin/("../../build/linux/kernel/ppc32/p3041ds.dtb");
			type = "flat_dt";
			arch = "powerpc";
			os = "linux";
			compression = "none";
			hash@1 {
				algo = "crc32";
			};
		};

		p4080ds-dtb {
			description = "p4080ds-dtb";
			data = /incbin/("../../build/linux/kernel/ppc32/p4080ds.dtb");
			type = "flat_dt";
			arch = "powerpc";
			os = "linux";
			compression = "none";
			hash@1 {
				algo = "crc32";
			};
		};

		p5040ds-dtb {
			description = "p5040ds-dtb";
			data = /incbin/("../../build/linux/kernel/ppc32/p5040ds.dtb");
			type = "flat_dt";
			arch = "powerpc";
			os = "linux";
			compression = "none";
			hash@1 {
				algo = "crc32";
			};
		};
	};

	configurations {
		mpc8548cds {
			description = "config for mpc8548cds";
			kernel = "kernel";
			ramdisk = "initrd";
			fdt = "mpc8548cds-dtb";
		};

		p1010rdb {
			description = "config for p1010rdb-pb";
			kernel = "kernel";
			ramdisk = "initrd";
			fdt = "p1010rdb-dtb";
		};

		p2020rdb {
			description = "config for p2020rdb-pc";
			kernel = "kernel";
			ramdisk = "initrd";
			fdt = "p2020rdb-dtb";
		};

		p2041rdb {
			description = "config for p2041rdb";
			kernel = "kernel";
			ramdisk = "initrd";
			fdt = "p2041rdb-dtb";
		};

		p3041ds {
			description = "config for p3041ds";
			kernel = "kernel";
			ramdisk = "initrd";
			fdt = "p3041ds-dtb";
		};

		p4080ds {
			description = "config for p4080ds";
			kernel = "kernel";
			ramdisk = "initrd";
			fdt = "p4080ds-dtb";
		};

		p5040ds {
			description = "config for p5040ds";
			kernel = "kernel";
			ramdisk = "initrd";
			fdt = "p5040ds-dtb";
		};
	};
};
```

## configs/linux/linux_ppc64.its
```
/*
 * Copyright 2017 NXP
 *
 */


/dts-v1/;

/ {
	description = "ppc64 kernel, ramdisk and FDT blob";
	#address-cells = <1>;

	images {
		kernel {
			description = "ppc64 Kernel";
			data = /incbin/("../../build/linux/kernel/ppc64/Image.gz");
			type = "kernel";
			arch = "powerpc";
			os = "linux";
			compression = "gzip";
			load = <0x0>;
			entry = <0x0>;
			hash@1 {
				algo = "crc32";
			};
		};

		initrd {
			description = "initrd for ppc64";
			data = /incbin/("../../packages/rfs/initrds/initrd.ppc64.cpio.gz");
			type = "ramdisk";
			arch = "powerpc";
			os = "linux";
			compression = "none";
			load = <0x1000000>;
			entry = <0x1000000>;
			hash@1 {
				algo = "crc32";
			};
		};

		t1023rdb-dtb {
			description = "t1023rdb-dtb";
			data = /incbin/("../../build/linux/kernel/ppc64/t1023rdb.dtb");
			type = "flat_dt";
			arch = "powerpc";
			os = "linux";
			compression = "none";
			hash@1 {
				algo = "crc32";
			};
		};

		t1024rdb-dtb {
			description = "t1024rdb-dtb";
			data = /incbin/("../../build/linux/kernel/ppc64/t1024rdb.dtb");
			type = "flat_dt";
			arch = "powerpc";
			os = "linux";
			compression = "none";
			hash@1 {
				algo = "crc32";
			};
		};

		t1042d4rdb-dtb {
			description = "t1042d4rdb-dtb";
			data = /incbin/("../../build/linux/kernel/ppc64/t1042d4rdb.dtb");
			type = "flat_dt";
			arch = "powerpc";
			os = "linux"; 
			compression = "none";
			hash@1 {
				algo = "crc32";
			};
		};

		t2080rdb-dtb {
			description = "t2080rdb-dtb";
			data = /incbin/("../../build/linux/kernel/ppc64/t2080rdb.dtb");
			type = "flat_dt";
			arch = "powerpc";
			os = "linux";
			compression = "none";
			hash@1 {
				algo = "crc32";
			};
		};

		t4240rdb-dtb {
			description = "t4240rdb-dtb";
			data = /incbin/("../../build/linux/kernel/ppc64/t4240rdb.dtb");
			type = "flat_dt";
			arch = "powerpc";
			os = "linux";
			compression = "none";
			hash@1 {
				algo = "crc32";
			};
		};
	};

	configurations {
		t1023rdb {
			description = "config for t1023rdb";
			kernel = "kernel";
			ramdisk = "initrd";
			fdt = "t1023rdb-dtb";
		};

		t1024rdb {
			description = "config for t1024rdb";
			kernel = "kernel";
			ramdisk = "initrd";
			fdt = "t1024rdb-dtb";
		};

		t1042d4rdb {
			description = "config for t1042d4rdb";
			kernel = "kernel";
			ramdisk = "initrd";
			fdt = "t1042d4rdb-dtb";
		}; 

		t2080rdb {
			description = "config for t2080rdb";
			kernel = "kernel";
			ramdisk = "initrd";
			fdt = "t2080rdb-dtb";
		};

		t4240rdb {
			description = "config for t4240rdb";
			kernel = "kernel";
			ramdisk = "initrd";
			fdt = "t4240rdb-dtb";
		};
	};
};
```

## ppa.its
```
/dts-v1/;

/{
	description = "PPA Firmware";
	#address-cells = <1>;
	images {
		firmware@1 {
			description = "PPA Firmware: Version LSDK-18.09";
			data = /incbin/("monitor.bin");
			type = "firmware";
			arch = "arm64";
			compression = "none";
		};
		trustedOS@1 {
			description = "Trusted OS";
			data = /incbin/("tee.bin");
			type = "OS";
			arch = "arm64";
			compression = "none";
			load = <0x00200000>;
		};
	};

	configurations {
		default = "config-1";
		config-1 {
			description = "PPA Secure firmware";
			firmware = "firmware@1";
			loadables = "trustedOS@1";
		};
	};
};
```
